## boards/arm/niuniu_gb34_rp2040/niuniu_gb34_rp2040_defconfig
```kconfig
# Copyright (c) 2023 The ZMK Contributors
# SPDX-License-Identifier: MIT

CONFIG_SOC_SERIES_RP2XXX=y
CONFIG_SOC_RP2040=y
CONFIG_BOARD_NIUNIU_GB34_RP2040=y

CONFIG_SYS_CLOCK_HW_CYCLES_PER_SEC=125000000

# Enable reset by default
CONFIG_RESET=y

# Code partition needed to target the correct flash range
CONFIG_USE_DT_CODE_PARTITION=y

# Output UF2 by default, native bootloader supports it.
CONFIG_BUILD_OUTPUT_UF2=y

CONFIG_SETTINGS=y
CONFIG_FLASH=y
CONFIG_FLASH_MAP=y
CONFIG_NVS=y

### ZMK CONFIG

CONFIG_ZMK_USB=y
```

## config/boards/Niuniu_GB34_RP2040/Kconfig.defconfig
```kconfig
# Copyright (c) 2023 The ZMK Contributors
# SPDX-License-Identifier: MIT

if BOARD_NIUNIU_GB34_RP2040

config ZMK_KEYBOARD_NAME
    default "Niuniu GB34"

config RP2_FLASH_W25Q080
    default y

endif # BOARD_NIUNIU_GB34_RP2040
```

## config/boards/arm/niuniu_gb34_rp2040/Kconfig.board
```kconfig
# Copyright (c) 2023 The ZMK Contributors
# SPDX-License-Identifier: Apache-2.0

config BOARD_NIUNIU_GB34_RP2040
    bool "Niuniu GB34"
    depends on SOC_RP2040
config ZMK_STUDIO 
```

## config/boards/shields/endgame/Kconfig.shield
```kconfig
# Copyright (c) 2021 The ZMK Contributors
# SPDX-License-Identifier: MIT

config SHIELD_ENDGAME
    def_bool $(shields_list_contains,endgame)
ZMK_STUDIO=y
CONFIG_BT_MAX_CONN=2
CONFIG_BT_MAX_PAIRED=2
```
